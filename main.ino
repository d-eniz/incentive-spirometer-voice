#include "talkie.h"

int trigPin = 11;    // Trigger
int echoPin = 12;    // Echo
long duration, cm, inches;
const int switchPin = 2;
int switchState = HIGH;

Talkie voice;


const uint8_t sp0[] PROGMEM = {0x69,0xFB,0x59,0xDD,0x51,0xD5,0xD7,0xB5,0x6F,0x0A,0x78,0xC0,0x52,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0xFF,0x1F};
const uint8_t sp1[] PROGMEM = {0x66,0x4E,0xA8,0x7A,0x8D,0xED,0xC4,0xB5,0xCD,0x89,0xD4,0xBC,0xA2,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0xFE,0x1F};
const uint8_t sp2[]  PROGMEM = {0x06,0xB8,0x59,0x34,0x00,0x27,0xD6,0x38,0x60,0x58,0xD3,0x91,0x55,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0xFF,0x1F};
const uint8_t sp3[] PROGMEM = {0x0C,0xE8,0x2E,0x94,0x01,0x4D,0xBA,0x4A,0x40,0x03,0x16,0x68,0x69,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0xFF,0x03};
const uint8_t sp4[] PROGMEM = {0x08,0x68,0x21,0x0D,0x03,0x1C,0x90,0xC0,0x88,0x92,0xB2,0x29,0x87,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0xFC,0x3F};
const uint8_t sp5[] PROGMEM = {0x08,0x68,0x4E,0x9D,0x02,0x1C,0x60,0xC0,0x8C,0x69,0x12,0xB0,0xC0,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0xFF,0x01};
const uint8_t sp6[] PROGMEM = {0x04,0xF8,0xB9,0x55,0x01,0xBF,0xA5,0x1B,0xE0,0x37,0x0F,0x03,0xFC,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0xFC,0x3F};
const uint8_t sp7[] PROGMEM = {0x0C,0x78,0xC6,0x95,0x01,0x3F,0xA5,0x28,0xE0,0xB7,0x52,0x0B,0x04,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0xFF,0x07};
const uint8_t sp8[] PROGMEM = {0xAD,0x1B,0xDE,0x58,0x23,0x17,0xAF,0x6E,0xE8,0x20,0xEB,0x5C,0xBC,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0xFF,0x0F};
const uint8_t sp9[] PROGMEM = {0x62,0x75,0xDC,0x33,0xB5,0x62,0xB9,0x25,0x0B,0x8E,0x34,0x8F,0xD3,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0xFF,0x03};
const uint8_t sp10[] PROGMEM = {0x0A,0xD8,0x5C,0x4D,0x03,0x2B,0xAB,0x5E,0xC4,0x33,0x2B,0xAF,0x62,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0xFD,0x7F};
const uint8_t sp11[] PROGMEM = {0x29,0x6F,0x52,0xA8,0xBB,0x6A,0x8F,0xBA,0x2B,0xC5,0xE8,0x9C,0xBD,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0xF4,0xFF};
const uint8_t sp12[] PROGMEM = {0x09,0x98,0xDA,0x22,0x01,0x37,0x78,0x1A,0x20,0x85,0xD1,0x50,0x3A,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0xFE,0x1F};
const uint8_t sp13[] PROGMEM = {0x08,0x18,0xA2,0x12,0x03,0x18,0x40,0xC0,0x50,0x13,0x25,0x1D,0x3A,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0xFC,0x7F};
const uint8_t sp14[] PROGMEM = {0x08,0xE8,0x2A,0x94,0x00,0xC3,0x56,0x10,0x60,0xFA,0x0A,0x01,0x4C,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0xFF,0x0F};
const uint8_t sp15[] PROGMEM = {0x02,0x68,0xD6,0xCC,0x00,0x43,0x9A,0x39,0x60,0x3A,0xF7,0x51,0x34,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0xFF,0x0F};
const uint8_t sp16[] PROGMEM = {0x0C,0x78,0xC6,0x95,0x01,0x3F,0xA5,0x28,0xE0,0xB7,0x52,0x0B,0x04,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0xFF,0x1F};
const uint8_t sp17[] PROGMEM = {0x0C,0xF8,0x29,0x45,0x01,0xBF,0x95,0x5A,0x20,0x00,0xBF,0xA5,0x3A,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0xFE,0x1F};
const uint8_t sp18[] PROGMEM = {0x6B,0x18,0x36,0x88,0x3B,0x1B,0xEF,0x61,0x0D,0xD3,0x27,0x52,0xE5,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0xFF,0x01};
const uint8_t sp19[] PROGMEM = {0x6E,0x2F,0x44,0xB4,0x5B,0x93,0xA6,0xAD,0x32,0x96,0x2E,0x69,0xBA,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0xFF,0x0F};
const uint8_t sp20[] PROGMEM = {0x0A,0xE8,0x4A,0xCD,0x01,0xDB,0xB9,0x33,0xC0,0xA6,0x54,0x0C,0xA4,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0xFF,0x1F};
const uint8_t sp30[] PROGMEM = {0x02,0x18,0xA2,0x52,0x02,0x16,0x60,0xC0,0x50,0x13,0x25,0x6B,0x2C,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0xFF,0x0F};
const uint8_t sp40[] PROGMEM = {0x04,0xC8,0xCE,0x8C,0x01,0xCB,0x94,0x33,0x60,0xDA,0x0C,0x01,0x0C,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0xFF,0x01};
const uint8_t sp50[] PROGMEM = {0x08,0x68,0x3A,0x05,0x01,0x5D,0xA4,0x12,0x60,0xD8,0x0A,0x02,0x4C,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0xFD,0xFF};
const uint8_t sp60[] PROGMEM = {0x06,0x78,0x90,0xC4,0x00,0x3F,0x66,0x18,0xE0,0xA7,0x8C,0x04,0x7C,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0xFF,0x0F};
const uint8_t sp70[] PROGMEM = {0x0C,0xF8,0x29,0x45,0x01,0xBF,0x95,0x5A,0x20,0x00,0xBF,0xA5,0x3A,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0xFA,0x7F};
const uint8_t sp80[] PROGMEM = {0x63,0xEA,0xD2,0x28,0x37,0x67,0xAD,0x7E,0xF9,0x26,0xAC,0x58,0xB3,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0xFF,0x0F};
const uint8_t sp90[] PROGMEM = {0x6E,0x28,0x1C,0xE3,0x38,0xB4,0xB8,0x3E,0x33,0xAA,0xE5,0xF0,0xB2,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0xFF,0x01};
const uint8_t sp100[] PROGMEM = {0x04,0xC8,0x7E,0x5C,0x02,0x0A,0xA8,0x62,0x43,0x03,0xA7,0xA8,0x62,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0xF9,0x7F};
const uint8_t sp1000[] PROGMEM = {0x0C,0xE8,0x2E,0xD4,0x02,0x06,0x98,0xD2,0x55,0x03,0x16,0x68,0x7D,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0xFF,0x0F};
const uint8_t spAND[] PROGMEM = {0x6B,0xA8,0x2E,0x79,0xAC,0x37,0xAE,0xA5,0xBA,0xE4,0xCE,0x5C,0xB8,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0xFF,0x03};
const uint8_t spSLOW[] PROGMEM = {0x0A,0xB8,0x9C,0xC4,0x00,0xBF,0x68,0x1A,0xE0,0x3F,0xF1,0x00,0xFC,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0xFC,0x3F};
const uint8_t spDOWN[] PROGMEM = {0x02,0x28,0x30,0x6C,0x55,0x4D,0x25,0xAB,0xF9,0xEA,0x55,0x57,0x9B,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0xFF,0x01};
const uint8_t spSPEED[] PROGMEM = {0x0C,0x78,0xC6,0x95,0x01,0x3F,0xA5,0x28,0xE0,0xB7,0x52,0x0B,0x04,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0xFF,0x01};
const uint8_t spUP[] PROGMEM = {0x69,0x2C,0x6A,0x32,0xCC,0x97,0xAC,0xA1,0xC8,0x4D,0x37,0x5F,0xB3,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0xFF,0x07};
const uint8_t spSAFE[] PROGMEM = {0x08,0xF8,0x39,0x4C,0x02,0x1A,0xD0,0x80,0x05,0x3C,0x60,0x81,0x95,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0xFF,0x07};
const uint8_t spSTART[] PROGMEM = {0x02,0xF8,0x49,0xCC,0x00,0xBF,0x87,0x3B,0xE0,0xB7,0x60,0x03,0xFC,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0xFE,0x1F};


void setup() {
  Serial.begin(9600);
  pinMode(trigPin, OUTPUT);
  pinMode(echoPin, INPUT);
  pinMode(switchPin, INPUT_PULLUP);
}

void loop() {
  Serial.println("New reading:");
  bool toneIndicator = true;
  bool hasPlayedTone = false;

  switchState = digitalRead(switchPin);
  while (switchState == LOW) {
    delay(50);
    switchState = digitalRead(switchPin);
  }
  bool fast = false;
  bool slow = false;

  // Wait until the object is further than 4cm away
  while (true) {
    digitalWrite(trigPin, LOW);
    delayMicroseconds(5);
    digitalWrite(trigPin, HIGH);
    delayMicroseconds(10);
    digitalWrite(trigPin, LOW);
    duration = pulseIn(echoPin, HIGH);
    cm = (duration/2) / 29.1;
    if (cm > 4) {
      break;
    }
  }



  // Record for 4 seconds
  voice.say(spSTART); //say something to indicate beginnning
  const int numReadings = 16;
  int distances[numReadings];
  for (int i = 0; i < numReadings; i++) {
    digitalWrite(trigPin, LOW);
    delayMicroseconds(5);
    digitalWrite(trigPin, HIGH);
    delayMicroseconds(10);
    digitalWrite(trigPin, LOW);
    duration = pulseIn(echoPin, HIGH);
    cm = (duration/2) / 29.1;
    distances[i] = cm;
    delay(250); // Wait for 500ms before taking the next reading
  }

  for (int i = 0; i < numReadings - 1; i++) {
    int difference = abs(distances[i] - distances[i+1]);
    Serial.print("The difference between this and the previous reading is:");
    Serial.println(difference*60.92);

    if (difference*60.92 > 300 and difference<2000) {
      fast = true;
    }
    else if (difference*60.92 < 100) {
      slow = true;
    }
  }

  if (fast==true and slow==true and distances[7]!=0){
    voice.say(spSAFE);
    voice.say(spSPEED);
    Serial.println("Safe speed");
  }
  else if (fast==true){
    voice.say(spSLOW);
    voice.say(spDOWN);
    Serial.println("slow down");
  }
  else if (slow==true){
    voice.say(spSPEED);
    voice.say(spUP);
    Serial.println("Speed up");
  }
  else{
    voice.say(spSAFE);
    voice.say(spSPEED);
    Serial.println("Safe speed");
  }
  // Calculate and display the final value
  int num = (distances[15]*60.92);
  int divisor = 1000;
  while (divisor >= 1) {
      int quotient = num / divisor;
      int number = quotient * divisor;
      if (number == 10){
        divisor /= 10;
        quotient = num/divisor;
        number = (quotient*divisor);
      }
      static_cast<char>(number);
      String sp = String("sp");
      String output = sp + number;
      num = num % divisor;
      divisor /= 10;

    if (output == "sp1"){
      voice.say(sp1);
    }
    if (output == "sp2"){
      voice.say(sp2);
    }
    if (output == "sp3"){
      voice.say(sp3);
    }
    if (output == "sp4"){
      voice.say(sp4);
    }
    if (output == "sp5"){
      voice.say(sp5);
    }
    if (output == "sp6"){
      voice.say(sp6);
    }
    if (output == "sp7"){
      voice.say(sp7);
    }
    if (output == "sp8"){
      voice.say(sp8);
    }
    if (output == "sp9"){
      voice.say(sp9);
    }
    if (output == "sp10"){
      voice.say(sp10);
    }
    if (output == "sp11"){
      voice.say(sp11);
    }
    if (output == "sp12"){
      voice.say(sp12);
    }
    if (output == "sp13"){
      voice.say(sp13);
    }
    if (output == "sp14"){
      voice.say(sp14);
    }
    if (output == "sp15"){
      voice.say(sp15);
    }
    if (output == "sp16"){
      voice.say(sp16);
    }
    if (output == "sp17"){
      voice.say(sp17);
    }
    if (output == "sp18"){
      voice.say(sp18);
    }
    if (output == "sp19"){
      voice.say(sp19);
    }
    if (output == "sp20"){
      voice.say(sp20);
    }
    if (output == "sp30"){
      voice.say(sp30);
    }
    if (output == "sp40"){
      voice.say(sp40);
    }
    if (output == "sp50"){
      voice.say(sp50);
    }
    if (output == "sp60"){
      voice.say(sp60);
    }
    if (output == "sp70"){
      voice.say(sp70);
    }
    if (output == "sp80"){
      voice.say(sp80);
    }
    if (output == "sp90"){
      voice.say(sp90);
    }
    if (output == "sp100"){
      voice.say(sp1);
      voice.say(sp100);
    }
    if (output == "sp200"){
      voice.say(sp2);
      voice.say(sp100);
    }
    if (output == "sp300"){
      voice.say(sp3);
      voice.say(sp100);
    }
    if (output == "sp400"){
      voice.say(sp4);
      voice.say(sp100);
    }
    if (output == "sp500"){
      voice.say(sp5);
      voice.say(sp100);
    }
    if (output == "sp600"){
      voice.say(sp6);
      voice.say(sp100);
    }
    if (output == "sp700"){
      voice.say(sp7);
      voice.say(sp100);
    }
    if (output == "sp800"){
      voice.say(sp8);
      voice.say(sp100);
    }
    if (output == "sp900"){
      voice.say(sp9);
      voice.say(sp100);
    }
    if (output == "sp1000"){
      voice.say(sp1000);
    }
  }


  delay(10000); // Wait for 10 seconds before taking another measurement,
}